## software/bringup-test/boards/mmaeder/e_reader_prototype/board.yml
```yaml
board:
  name: e_reader_prototype
  full_name: e_reader_prototype
  vendor: mmaeder
  socs:
    - name: nrf52840
```

## software/bringup-test/boards/mmaeder/e_reader_prototype/e_reader_prototype_defconfig
```kconfig
CONFIG_ARM_MPU=y

CONFIG_CLOCK_CONTROL_NRF_K32SRC_RC=y
CONFIG_CLOCK_CONTROL_NRF_K32SRC_RC_CALIBRATION=n

CONFIG_SERIAL=y
CONFIG_CONSOLE=y
CONFIG_UART_CONSOLE=y
CONFIG_STDOUT_CONSOLE=y
CONFIG_UART_LINE_CTRL=y

CONFIG_USB_DEVICE_STACK_NEXT=y
CONFIG_USBD_CDC_ACM_CLASS=y
CONFIG_CDC_ACM_SERIAL_INITIALIZE_AT_BOOT=y
CONFIG_CDC_ACM_SERIAL_ENABLE_AT_BOOT=y

CONFIG_CDC_ACM_SERIAL_PRODUCT_STRING="E-Reader Prototype"

CONFIG_GPIO=y
CONFIG_I2C=y
CONFIG_REGULATOR=y
CONFIG_MFD=y
CONFIG_LED=y
CONFIG_INPUT=y

CONFIG_REGULATOR_NPM13XX=y
CONFIG_MFD_NPM13XX=y
CONFIG_LED_NPM13XX=y
CONFIG_GPIO_NPM13XX=y

CONFIG_SPI=y
CONFIG_DISK_ACCESS=y
CONFIG_DISK_DRIVER_SDMMC=y
CONFIG_SDHC=y
CONFIG_SDMMC_STACK=y
CONFIG_SPI_NRFX_RAM_BUFFER_SIZE=512

CONFIG_FILE_SYSTEM=y
CONFIG_FAT_FILESYSTEM_ELM=y
CONFIG_FS_FATFS_LFN=y
CONFIG_FS_FATFS_LFN_MODE_HEAP=y
```

## software/bringup-test/drivers/display/Kconfig
```kconfig
config EPD_SE8350
	bool "SE8350 e-Paper display driver"
	default y
	depends on MIPI_DBI && SPI
	help
	  Driver for the SE8350 EPD controller (UC8179-compatible command set)
	  used in Waveshare 5-inch e-Paper displays (960x552).
```

## software/bringup-test/drivers/input/Kconfig
```kconfig
# Copyright (c) 2025 Max Maeder
# SPDX-License-Identifier: Apache-2.0

config INPUT_IQS323
	bool "Azoteq IQS323 3-channel capacitive touch sensor"
	default y
	depends on DT_HAS_AZOTEQ_IQS323_ENABLED
	select I2C
	select GPIO
	help
	  Enable driver for the Azoteq IQS323 ProxFusion IC in 3-button
	  self-capacitance mode.  Touch events are reported through the
	  Zephyr input subsystem.
```
